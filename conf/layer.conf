## conf/layer.conf
```bitbake
BBPATH .= ":${LAYERDIR}"

BBFILES += "${LAYERDIR}/recipes-*/*/*.bb \
            ${LAYERDIR}/recipes-*/*/*.bbappend"

BBFILE_COLLECTIONS += "meta-fieldkit"
BBFILE_PATTERN_meta-fieldkit = "^${LAYERDIR}/"
BBFILE_PRIORITY_meta-fieldkit = "20"

LAYERDEPENDS_meta-fieldkit = "core"
LAYERSERIES_COMPAT_meta-fieldkit = "scarthgap"
```
